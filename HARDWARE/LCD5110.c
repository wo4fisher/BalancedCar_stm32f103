#include "LCD5110.h"

/*-----------------------------------------------------------------------
*****函数名称：LCD5110_clear()
*****函数功能: LCD5110液晶清屏函数
*****最后修改日期     ：2016-6-29
-----------------------------------------------------------------------*/
void LCD5110_clear(void)
{
    uint16_t i;
    LCD5110_write_byte(0x0c, 0);
    LCD5110_write_byte(0x80, 0);			
    for (i=0; i<504; i++)
        LCD5110_write_byte(0, 1);			
}

/*-----------------------------------------------------------------------
LCD5110_write_byte : 使用SPI接口写数据到LCD
函数功能           ：写一个字节
输入参数：data     ：写入的字节；
          command  ：写数据/命令选择；0为命令，1为数据；

最后修改日期       ：2014-3-7
-----------------------------------------------------------------------*/
void LCD5110_write_byte(uint8_t data, uint8_t command)
{
    uint8_t i;

    LCD5110_CE = 0;   // 使能LCD

    if (command == 0)
     LCD5110_DC = 0;         // 传送命令
    else 		
     LCD5110_DC = 1;         // 传送数据
		for(i=0;i<8;i++)
		{
			if(data&0x80)
				 LCD5110_SDIN = 1;
			else
				 LCD5110_SDIN = 0;
			LCD5110_SCLK = 0;
			data = data << 1;
			LCD5110_SCLK = 1;
		}
    LCD5110_CE  = 1;
  }


/*-----------------------------------------------------------------------
*****LCD5110_set_XY()    : 设置LCD坐标函数

*****输入参数：X       ：0－83
               Y       ：0－5

*****最后修改日期      ：2014-3-7
-----------------------------------------------------------------------*/
void LCD5110_set_XY(uint8_t X, uint8_t Y)
{
    LCD5110_write_byte(0x40 | Y, 0);		// column
    LCD5110_write_byte(0x80 | X, 0);        // row
}


/*-----------------------------------------------------------------------
LCD5110_write_char()  : 写入1个英文字符

输入参数：c           ：要显示的字符；

最后修改日期          ：2014-3-7
-----------------------------------------------------------------------*/
void LCD5110_write_char(uint8_t c)
{
    uint8_t line;

    c -= 32;

    for (line=0; line<6; line++)
      LCD5110_write_byte(font6x8[c][line], 1);//从ACSII码表中读取字节，然后写入液晶
  }

/***********************************************************************
* 函数名称：LCD5110_Write_Char()
* 函数功能：定位的写入1个字符
* 入口参数：X:行;Y:列;c:要写入的数据
* 修改时间：2014-03-07
**********************************************************************/
void LCD5110_Write_Char(uint8_t X,uint8_t Y,uint8_t c)
{
  uint8_t line;
  LCD5110_set_XY(X,Y);    //光标定位

    c-=32;
  for (line=0; line<6; line++)
    LCD5110_write_byte(font6x8[c][line], 1);//从ACSII码表中读取字节，然后写入液晶
}


/***********************************************************************
* 函数名称：LCD5110_Write_Num()
* 函数功能：定位 显示变量
* 入口参数：X:行;Y:列;num:变量;N:要显示的变量的位数

* 修改时间：2014-03-07
**********************************************************************/
void LCD5110_Write_Num(uint8_t X,uint8_t Y,uint16_t num)
{
    uint8_t line;
    uint8_t i=0;
    uint16_t n[5]={0};
    uint8_t  N=0;
    if(num<10)
      N=1;
    else if(num<100)
      N=2;
    else if(num<1000)
      N=3;
    else if(num<10000)
      N=4;
    else 
      N=5;
    n[0]= num%10;
    n[1]=(num/10)%10;
    n[2]=(num/100)%10;
    n[3]=(num/1000)%10;
    n[4]=(num/10000)%10;
    for(i=0;i<5;i++) n[i]=n[i]+16;
    for(i=N;i>0;i--)
    {
        LCD5110_set_XY(X+(N-i)*6,Y);//光标定位
        for (line=0; line<6; line++)
            LCD5110_write_byte(font6x8[n[i-1]][line], 1);//从ACSII码表中读取字节，然后写入液晶
    }
}
/*-----------------------------------------------------------------------
LCD5110_write_english_String()  : 英文字符串显示函数

输入参数：*s      ：英文字符串指针；
        X、Y    : 显示字符串的位置,x 0-83 ,y 0-5

最后修改日期      ：2014-3-7 		
-----------------------------------------------------------------------*/
void LCD5110_write_english_string(uint8_t X,uint8_t Y,int8_t *s)
{
    //LCD5110_set_XY(X,Y);     //光标定位
    while (*s)
      {
            LCD5110_Write_Char(X,Y,*s);
            s++;
            X+=6;
            if(X>83)
            {
                X=0;
                Y+=1;
            }
      }
}
/*-----------------------------------------------------------------------
LCD5110_write_chinese_string: 在LCD上显示汉字
输入参数：X、Y    ：显示汉字的起始X、Y坐标；
          ch_with ：汉字点阵的宽度
          num     ：显示汉字的个数；
          line    ：汉字点阵数组中的起始行数
          row     ：汉字显示的行间距
最后修改日期      ：2014-03-07
测试：
	LCD5110_write_chi(0,0,12,7,0,0);
	LCD5110_write_chi(0,2,12,7,0,0);
	LCD5110_write_chi(0,4,12,7,0,0);	
-----------------------------------------------------------------------*/
void LCD5110_write_chinese_string(uint8_t X, uint8_t Y,
                   uint8_t ch_with,uint8_t num,
                   uint8_t line,uint8_t row)
{
    uint8_t i,n;

    LCD5110_set_XY(X,Y);                         //设置初始位置

    for (i=0;i<num;)
      {
      	for (n=0; n<ch_with*2; n++)              //写一个汉字
      	  {
      	    if (n==ch_with)                      //写汉字的下半部分
      	      {
      	        if (i==0) LCD5110_set_XY(X,Y+1);
      	        else
   	           LCD5110_set_XY((X+(ch_with+row)*i),Y+1);
              }
      	    LCD5110_write_byte(write_chinese[line+i][n],1);
      	  }
      	i++;
      	LCD5110_set_XY((X+(ch_with+row)*i),Y);
      }
}



/*-----------------------------------------------------------------------
LCD5110_draw_map_pixel()    : 位图绘制函数

输入参数：X、Y    ：位图绘制的起始X、Y坐标；
         *map    ：位图点阵数据；
          Pix_x   ：位图像素（长）
          Pix_y   ：位图像素（宽）

最后修改日期      ：2014-3-7
-----------------------------------------------------------------------*/
void LCD5110_draw_bmp_pixel(uint8_t X,uint8_t Y,uint8_t *map,
                            uint8_t Pix_x,uint8_t Pix_y)
{
    uint16_t i,n;
    uint8_t row;

    if (Pix_y%8==0)       //如果位图所占行数为整数
        row=Pix_y/8;      //计算位图所占行数
      else
     row=Pix_y/8+1;    //如果位图所占函数不为整数

    for (n=0;n<row;n++)
      {
      	LCD5110_set_XY(X,Y);
        for(i=0; i<Pix_x; i++)
          {
            LCD5110_write_byte(map[i+n*Pix_x], 1);
          }
        Y++;                         //换行
      }
  }

/*-----------------------------------------------------------------------
*****函数名称：     LCD5110_init()
*****函数功能:      5110LCD初始化
*****最后修改日期 ：2014-3-7
-----------------------------------------------------------------------*/
void LCD5110_init(void)
{
    RCC->APB2ENR|=1<<2; //开启gpioA时钟
	GPIOA->CRL&=0XFF0000FF;//PA2、3、4、5输出 
	GPIOA->CRL|=0X00333300;//推挽功能输出
	GPIOA->CRH&=0XFFFFFFF0;//PA2、3、4、5输出 
	GPIOA->CRH|=0X00000003;//推挽功能输出
	LCD5110_SCLK=1;
	LCD5110_SDIN=1;
	LCD5110_DC=1;
	LCD5110_CE=1;
	
    LCD5110_RST = 0;      // 产生一个让LCD复位的低电平脉冲
    delay_us(1);
    LCD5110_RST = 1;
        
    LCD5110_CE = 0;         // 关闭LCD
    delay_us(1);
                
    LCD5110_CE = 1;       // 使能LCD
    delay_us(1);

    LCD5110_write_byte(0x21, 0);	// 使用扩展命令设置LCD模式
    LCD5110_write_byte(0xc8, 0);	// 设置偏置电压
    LCD5110_write_byte(0x06, 0);	// 温度校正
    LCD5110_write_byte(0x13, 0);	// 1:48
    LCD5110_write_byte(0x20, 0);	// 使用基本命令
    LCD5110_clear();	          // 清屏
    LCD5110_write_byte(0x0c, 0);	// 设定显示模式，正常显示


   LCD5110_CE = 0;         // 关闭LCD
}




/********LCD5110 库*********/
// 6 x 8 font
// ASCII码编码表
// index = ASCII - 32
   uint8_t font6x8[][6] =
{
    {0x00,0x00,0x00,0x00,0x00,0x00},// (0)
    {0x00,0x00,0x00,0x4F,0x00,0x00},//!(1)
    {0x00,0x00,0x07,0x00,0x07,0x00},//"(2)
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    {0x14,0x14,0x14,0x14,0x14,0x14}// horiz lines(133)
};

//-------------------------------------汉字字库---------------------------------------------------------------------------------
//Index[2];//一个汉字占两个字节
//Msk[24];//一个汉字的编码由24个十六进制数组成
uint8_t write_chinese[][24]={

//测(1)
	{0x89,0xF2,0x00,0xFF,0x01,0xF9,0xFF,0x00,0xFC,0x00,0xFF,0x00,0x00,0x07,0x04,0x04,0x02,0x01,0x02,0x04,0x01,0x04,0x07,0x00},
//试(2)
	{0x11,0xF6,0x00,0x04,0x24,0xE4,0x24,0x24,0xFF,0x05,0x06,0x00,0x00,0x07,0x02,0x01,0x02,0x03,0x01,0x01,0x01,0x02,0x07,0x00},
//程(3)
	{0x8A,0x6A,0xFF,0x49,0x20,0xAF,0xA9,0xE9,0xA9,0xAF,0x20,0x00,0x01,0x00,0x07,0x00,0x04,0x04,0x04,0x07,0x04,0x04,0x04,0x00},
//序(4)
	{0x00,0xFE,0x42,0x4A,0x4A,0x5B,0xEA,0x5A,0x4A,0xC2,0x42,0x00,0x06,0x01,0x00,0x00,0x04,0x04,0x07,0x00,0x00,0x00,0x00,0x00},


//电(5)
	{0x00,0xFC,0x94,0x94,0x94,0xFF,0x94,0x94,0x94,0xFE,0x04,0x00,0x00,0x01,0x00,0x00,0x00,0x03,0x04,0x04,0x04,0x04,0x06,0x00},
//子(6)
	{0x20,0x21,0x21,0x21,0x21,0xF9,0x29,0x25,0x23,0x31,0x20,0x00,0x00,0x00,0x00,0x04,0x04,0x07,0x00,0x00,0x00,0x00,0x00,0x00},
//制(7)
	{0x18,0xD6,0x54,0xFF,0x54,0x56,0xD4,0x00,0xFC,0x00,0xFF,0x00,0x00,0x03,0x00,0x07,0x00,0x02,0x03,0x00,0x04,0x04,0x07,0x00},
//作(8)
	{0x10,0x08,0xFC,0x13,0x08,0x04,0xFF,0x24,0x24,0x24,0x04,0x00,0x00,0x00,0x07,0x00,0x00,0x00,0x07,0x01,0x01,0x01,0x01,0x00},
//杂(9)
	{0x40,0x62,0x52,0xCA,0x47,0xE2,0x42,0xDE,0x50,0x50,0x58,0x00,0x04,0x02,0x01,0x04,0x04,0x07,0x00,0x00,0x01,0x02,0x04,0x00},
//志(10)
	{0x04,0xA4,0x24,0xA4,0x24,0xBF,0x24,0x24,0x24,0xA6,0x04,0x00,0x02,0x01,0x00,0x07,0x04,0x04,0x05,0x04,0x06,0x00,0x03,0x00},
//社(11)
	{0x84,0x44,0xF5,0x2E,0x40,0x10,0x10,0xFF,0x10,0x10,0x10,0x00,0x00,0x00,0x07,0x00,0x04,0x04,0x04,0x07,0x04,0x04,0x04,0x00},
	};

/*------------------------------------------------------------------------------
;  宽×高（像素）: 40×24
;  字模格式/大小 : 单色点阵液晶字模，纵向取模，字节倒序/120字节
;  数据转换日期  : 2014-3-7
------------------------------------------------------------------------------*/
uint8_t  AVR_bmp[]=
 {
/*--  调入了一幅图像：C:\Documents and Settings\armok\桌面\1.bmp  --*/
/*--  宽度x高度=60x47  --*/    /*
0x00,0x00,0x00,0x00,0x80,0xE0,0xFC,0xFF,0xFF,0xFF,0x7F,0xFF,0xFE,0xFC,0xF0,0xC1,
0x0F,0x7F,0xFF,0xFF,0xFE,0xF0,0xC0,0x00,0x00,0x00,0xC0,0xF8,0xFE,0xFF,0xFF,0x3F,
0x07,0xC1,0xF0,0xFE,0xFF,0xFF,0xFF,0x1F,0x07,0x8F,0xCF,0xFF,0xFF,0xFF,0xFE,0xFC,
0x00,0x80,0xF0,0xFC,0xFF,0xFF,0xFF,0x7F,0x7F,0x78,0x78,0x79,0x7F,0x7F,0xFF,0xFF,
0xFC,0xF0,0xC1,0x07,0x1F,0xFF,0xFF,0xFE,0xFC,0xFF,0xFF,0xFF,0x1F,0x07,0xC1,0xF0,
0xFE,0xFF,0xFF,0x3F,0x0F,0x0F,0x7F,0xFF,0xFF,0xFF,0xFF,0xE7,0x07,0x03,0x01,0x00,
0x02,0x03,0x03,0x03,0x03,0x03,0x00,0x00,0x00,0x00,0x00,0x00,0x00,0x00,0x00,0x03,
0x03,0x03,0x03,0x03,0x00,0x00,0x03,0x1F,0x3F,0x1F,0x07,0x00,0x00,0x02,0x03,0x03,
0x03,0x03,0x01,0x00,0x00,0x00,0x00,0x03,0x03,0x03,0x03,0x03,0x03,0x00,0x00,0x00
 */

0x00,0x00,0x00,0x00,0x00,0x00,0x00,0x00,0x00,0x00,0x00,0x00,0x00,0x80,0xC0,0x40,
0x20,0x00,0x10,0x10,0x00,0x08,0x08,0x08,0x08,0x08,0x08,0x08,0x00,0x10,0x10,0x00,
0x20,0x40,0xC0,0x80,0x00,0x00,0x00,0x00,0x00,0x00,0x00,0x00,0x00,0x00,0x00,0x00,
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0x00,0x00,0x00,0x00,0x00,0x00,0x00,0x00,0x00,0x00,0x00,0x00,0x00,0x00
 };
 